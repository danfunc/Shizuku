## CMakeLists.txt
```
# Zephyr userspace IPC cost benchmark for RP2350 (Pico 2, Cortex-M33).
cmake_minimum_required(VERSION 3.28.0)
find_package(Zephyr REQUIRED HINTS $ENV{ZEPHYR_BASE})
project(zephyr_ipc_bench)

# Custom syscalls (bench_stamp / bench_nop) are declared in include/bench_sc.h.
zephyr_syscall_include_directories(${CMAKE_CURRENT_SOURCE_DIR}/include)
target_include_directories(app PRIVATE include)
target_sources(app PRIVATE src/main.c src/bench_sc.c)

# Optional variant: put the kernel and the ARM arch code in SRAM (-DBENCH_SRAM=ON,
# which build.sh passes with "sram"). Shizuku's RP2350 places its svc path in SRAM.
if(BENCH_SRAM)
  # Not the whole kernel library and not arm_mpu.c / arm_core_mpu.c: on RP2350 (XIP) the SRAM
  # is execute-never in the SoC's fixed MPU regions, and arch_kernel_init() (inlined in
  # z_cstart, kernel/init.c) enables the MPU in z_arm_mpu_init() *before*
  # z_arm_configure_static_mpu_regions() adds the executable region for the relocated text
  # (kernel_arch_func.h:49-56). Anything that runs in between, or returns into SRAM from the
  # MPU enable, takes an instruction-access fault. So init.c and the two MPU files stay in
  # flash (the MPU reprogramming on each switch therefore runs from flash), and only
  # steady-state kernel code that is first used after that is moved.
  set(KERNEL_DIR ${ZEPHYR_BASE}/kernel)
  foreach(f sched.c scheduler.c msg_q.c sem.c timeout.c sleep.c thread.c userspace/mem_domain.c)
    if(EXISTS ${KERNEL_DIR}/${f})
      zephyr_code_relocate(FILES ${KERNEL_DIR}/${f} LOCATION RAM)
    endif()
  endforeach()
  set(ARCH_ARM ${ZEPHYR_BASE}/arch/arm/core)
  zephyr_code_relocate(FILES ${ARCH_ARM}/userspace.S LOCATION RAM)
  zephyr_code_relocate(FILES ${ARCH_ARM}/cortex_m/svc.S LOCATION RAM)
  zephyr_code_relocate(FILES ${ARCH_ARM}/cortex_m/swap_helper.S LOCATION RAM)
  zephyr_code_relocate(FILES ${ARCH_ARM}/cortex_m/thread.c LOCATION RAM)
  zephyr_code_relocate(FILES ${ARCH_ARM}/cortex_m/exc_exit.c LOCATION RAM)
endif()
```

## prj.conf
```kconfig
# --- console over USB CDC ACM (results are read from the host) ---
CONFIG_SERIAL=y
CONFIG_CONSOLE=y
CONFIG_UART_CONSOLE=y
CONFIG_PRINTK=y
CONFIG_UART_LINE_CTRL=y
CONFIG_USB_DEVICE_STACK_NEXT=y
CONFIG_CDC_ACM_SERIAL_INITIALIZE_AT_BOOT=y
CONFIG_CDC_ACM_SERIAL_PID=0x0005
CONFIG_CDC_ACM_SERIAL_PRODUCT_STRING="Zephyr IPC bench"

# --- what is under test ---
CONFIG_ARM_MPU=y
CONFIG_USERSPACE=y
CONFIG_FPU=n
CONFIG_MP_MAX_NUM_CPUS=1
CONFIG_SYS_CLOCK_TICKS_PER_SEC=1000

# --- speed first, no checks on the measured path ---
CONFIG_SPEED_OPTIMIZATIONS=y
CONFIG_ASSERT=n
CONFIG_LOG=n
CONFIG_STACK_SENTINEL=n
CONFIG_INIT_STACKS=n
CONFIG_THREAD_NAME=n
CONFIG_TIMESLICING=n
CONFIG_BOOT_BANNER=n
CONFIG_THREAD_MONITOR=n
CONFIG_STACK_USAGE=n
CONFIG_DEBUG=n
CONFIG_NO_OPTIMIZATIONS=n

# --- thread / queue sizing for the sweeps ---
CONFIG_NUM_PREEMPT_PRIORITIES=30
CONFIG_MAIN_STACK_SIZE=4096
CONFIG_ISR_STACK_SIZE=2048
CONFIG_PICOLIBC=y

# app-defined syscalls (bench_stamp / bench_nop): scans the app source dir
CONFIG_APPLICATION_DEFINED_SYSCALL=y
CONFIG_MAX_THREAD_BYTES=12
CONFIG_CRC=y
```

## app.overlay
```dts
/ {
	chosen {
		zephyr,console = &cdc_acm_uart0;
	};
};

&zephyr_udc0 {
	cdc_acm_uart0: cdc_acm_uart0 {
		compatible = "zephyr,cdc-acm-uart";
		/* A full result dump is ~14 KB; poll_out drops bytes when the FIFO is full
		 * and flow control is off, so make it larger than one dump. */
		tx-fifo-size = <20480>;
	};
};
```

## include/bench_sc.h
```c
/* Custom syscalls for the benchmark. */
#ifndef BENCH_SC_H_
#define BENCH_SC_H_
#include <zephyr/kernel.h>

/* Returns DWT->CYCCNT. Used to take one timestamp at a time from a user thread. */
__syscall uint32_t bench_stamp(void);

/* Does nothing; the verifier only checks the argument. Returns a constant. */
__syscall uint32_t bench_nop(uint32_t arg);

#include <zephyr/syscalls/bench_sc.h>
#endif
```

## src/bench_sc.c
```c
#include <zephyr/kernel.h>
#include <zephyr/internal/syscall_handler.h>
#include <cmsis_core.h>
#include "bench_sc.h"

uint32_t z_impl_bench_stamp(void)
{
	return DWT->CYCCNT;
}

static inline uint32_t z_vrfy_bench_stamp(void)
{
	return z_impl_bench_stamp();
}
#include <zephyr/syscalls/bench_stamp_mrsh.c>

uint32_t z_impl_bench_nop(uint32_t arg)
{
	(void)arg;
	return 0x1234u;
}

static inline uint32_t z_vrfy_bench_nop(uint32_t arg)
{
	/* "only checks the argument" */
	K_OOPS(K_SYSCALL_VERIFY(arg != 0xffffffffu));
	return z_impl_bench_nop(arg);
}
#include <zephyr/syscalls/bench_nop_mrsh.c>
```
